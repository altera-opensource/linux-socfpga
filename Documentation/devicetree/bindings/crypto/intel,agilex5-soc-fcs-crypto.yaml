## Documentation/devicetree/bindings/crypto/intel,agilex5-soc-fcs-crypto.yaml
```yaml
# SPDX-License-Identifier: (GPL-2.0-only OR BSD-2-Clause)
%YAML 1.2
---
$id: http://devicetree.org/schemas/crypto/intel,agilex5-soc-fcs-crypto.yaml#
$schema: http://devicetree.org/meta-schemas/core.yaml#

title: Altera SoCFPGA Crypto module

maintainers:
  - Balsundar Ponnusamy <balsundar.ponnusamy@altera.com>
  - Sagar Khadgi <sagar.khadgi@altera.com>
  - Santosh Male <santosh.male@altera.com>
  - Mahesh Rao <mahesh.rao@altera.com>

properties:
  compatible:
    enum:
      - intel,agilex5-soc-fcs-crypto
      - intel,agilex-soc-fcs-crypto

additionalProperties: false

required:
  - compatible

examples:
  - |
    fcs_crypto: fcs-crypto {
      compatible = "intel,agilex5-soc-fcs-crypto";
    };
```

## Documentation/devicetree/bindings/misc/intel,agilex5-soc-fcs-config.yaml
```yaml
# SPDX-License-Identifier: (GPL-2.0-only OR BSD-2-Clause)
%YAML 1.2
---
$id: http://devicetree.org/schemas/misc/intel,agilex5-soc-fcs-config.yaml#
$schema: http://devicetree.org/meta-schemas/core.yaml#

title: Altera SoC FPGA Security features

maintainers:
  - Balsundar Ponnusamy <balsundar.ponnusamy@altera.com>
  - Sagar Khadgi <sagar.khadgi@altera.com>
  - Santosh Male <santosh.male@altera.com>
  - Mahesh Rao <mahesh.rao@altera.com>

properties:
  compatible:
    enum:
      - intel,agilex5-soc-fcs-config
      - intel,agilex-soc-fcs-config

additionalProperties: false

required:
  - compatible

examples:
  - |
    fcs_config: fcs-config {
      compatible = "intel,agilex5-soc-fcs-config";
    };
```

## Documentation/devicetree/bindings/misc/intel,agilex5-soc-fcs-hal.yaml
```yaml
# SPDX-License-Identifier: (GPL-2.0-only OR BSD-2-Clause)
%YAML 1.2
---
$id: http://devicetree.org/schemas/misc/intel,agilex5-soc-fcs-hal.yaml#
$schema: http://devicetree.org/meta-schemas/core.yaml#

title: Altera SoC FPGA HAL

maintainers:
  - Balsundar Ponnusamy <balsundar.ponnusamy@altera.com>
  - Sagar Khadgi <sagar.khadgi@altera.com>
  - Santosh Male <santosh.male@altera.com>
  - Mahesh Rao <mahesh.rao@altera.com>

properties:
  compatible:
    enum:
      - intel,agilex5-soc-fcs-hal
      - intel,agilex-soc-fcs-hal

required:
  - compatible

additionalProperties: false

examples:
  - |
    firmware {
      svc {
        fcs_hal: fcs-hal {
          compatible = "intel,agilex5-soc-fcs-hal";
        };
      };
    };
```

## Documentation/devicetree/bindings/mmc/cdns,sdhci.yaml
```yaml
# SPDX-License-Identifier: GPL-2.0-only OR BSD-2-Clause
%YAML 1.2
---
$id: http://devicetree.org/schemas/mmc/cdns,sdhci.yaml#
$schema: http://devicetree.org/meta-schemas/core.yaml#

title: Cadence SD/SDIO/eMMC Host Controller (SD4HC/SD6HC)

maintainers:
  - Masahiro Yamada <yamada.masahiro@socionext.com>

properties:
  compatible:
    oneOf:
      - description: Cadence SD4HC controller
        items:
          - enum:
              - amd,pensando-elba-sd4hc
              - microchip,mpfs-sd4hc
              - microchip,pic64gx-sd4hc
              - mobileye,eyeq-sd4hc
              - socionext,uniphier-sd4hc
          - const: cdns,sd4hc
      - description: Cadence SD6HC controller
        items:
          - const: cdns,sd6hc

  reg:
    minItems: 1
    maxItems: 2

  interrupts:
    maxItems: 1

  clocks:
    maxItems: 1

  resets:
    maxItems: 1

  # PHY DLL input delays:
  # They are used to delay the data valid window, and align the window to
  # sampling clock. The delay starts from 5ns (for delay parameter equal to 0)
  # and it is increased by 2.5ns in each step.

  cdns,phy-input-delay-sd-highspeed:
    description: Value of the delay in the input path for SD high-speed timing
    $ref: /schemas/types.yaml#/definitions/uint32
    minimum: 0
    maximum: 0x1f

  cdns,phy-input-delay-legacy:
    description: Value of the delay in the input path for legacy timing
    $ref: /schemas/types.yaml#/definitions/uint32
    minimum: 0
    maximum: 0x1f

  cdns,phy-input-delay-sd-uhs-sdr12:
    description: Value of the delay in the input path for SD UHS SDR12 timing
    $ref: /schemas/types.yaml#/definitions/uint32
    minimum: 0
    maximum: 0x1f

  cdns,phy-input-delay-sd-uhs-sdr25:
    description: Value of the delay in the input path for SD UHS SDR25 timing
    $ref: /schemas/types.yaml#/definitions/uint32
    minimum: 0
    maximum: 0x1f

  cdns,phy-input-delay-sd-uhs-sdr50:
    description: Value of the delay in the input path for SD UHS SDR50 timing
    $ref: /schemas/types.yaml#/definitions/uint32
    minimum: 0
    maximum: 0x1f

  cdns,phy-input-delay-sd-uhs-ddr50:
    description: Value of the delay in the input path for SD UHS DDR50 timing
    $ref: /schemas/types.yaml#/definitions/uint32
    minimum: 0
    maximum: 0x1f

  cdns,phy-input-delay-mmc-highspeed:
    description: Value of the delay in the input path for MMC high-speed timing
    $ref: /schemas/types.yaml#/definitions/uint32
    minimum: 0
    maximum: 0x1f

  cdns,phy-input-delay-mmc-ddr:
    description: Value of the delay in the input path for eMMC high-speed DDR timing

  # PHY DLL clock delays:
  # Each delay property represents the fraction of the clock period.
  # The approximate delay value will be
  # (<delay property value>/128)*sdmclk_clock_period.
    $ref: /schemas/types.yaml#/definitions/uint32
    minimum: 0
    maximum: 0x1f

  cdns,phy-dll-delay-sdclk:
    description: |
      Value of the delay introduced on the sdclk output for all modes except
      HS200, HS400 and HS400_ES.
    $ref: /schemas/types.yaml#/definitions/uint32
    minimum: 0
    maximum: 0x7f

  cdns,phy-dll-delay-sdclk-hsmmc:
    description: |
      Value of the delay introduced on the sdclk output for HS200, HS400 and
      HS400_ES speed modes.
    $ref: /schemas/types.yaml#/definitions/uint32
    minimum: 0
    maximum: 0x7f

  cdns,phy-dll-delay-strobe:
    description: |
      Value of the delay introduced on the dat_strobe input used in
      HS400 / HS400_ES speed modes.
    $ref: /schemas/types.yaml#/definitions/uint32
    minimum: 0
    maximum: 0x7f

  # SD6HC PHY timing properties:
  cdns,iocell-input-delay:
    description: Input delay across IO cells in picoseconds
    $ref: /schemas/types.yaml#/definitions/uint32
    minimum: 0
    maximum: 20000   # 20 ns

  cdns,iocell-output-delay:
    description: Output delay across IO cells in picoseconds
    $ref: /schemas/types.yaml#/definitions/uint32
    minimum: 0
    maximum: 20000   # 20 ns

  cdns,delay-element:
    description: Delay element size in picoseconds
    $ref: /schemas/types.yaml#/definitions/uint32
    minimum: 1
    maximum: 1000

required:
  - compatible
  - reg
  - interrupts
  - clocks

allOf:
  - $ref: sdhci-common.yaml
  - if:
      properties:
        compatible:
          contains:
            const: amd,pensando-elba-sd4hc
    then:
      properties:
        reg:
          items:
            - description: Host controller registers
            - description: Elba byte-lane enable register for writes
      required:
        - resets
    else:
      properties:
        reg:
          maxItems: 1

  - if:
      properties:
        compatible:
          contains:
            const: cdns,sd6hc
    then:
      description: SD6HC variant - use IO-cell and delay element properties
      properties:
        cdns,phy-input-delay-sd-highspeed: false
        cdns,phy-input-delay-legacy: false
        cdns,phy-input-delay-sd-uhs-sdr12: false
        cdns,phy-input-delay-sd-uhs-sdr25: false
        cdns,phy-input-delay-sd-uhs-sdr50: false
        cdns,phy-input-delay-sd-uhs-ddr50: false
        cdns,phy-input-delay-mmc-highspeed: false
        cdns,phy-input-delay-mmc-ddr: false
        cdns,phy-dll-delay-sdclk: false
        cdns,phy-dll-delay-sdclk-hsmmc: false
        cdns,phy-dll-delay-strobe: false

  - if:
      properties:
        compatible:
          contains:
            const: cdns,sd4hc
    then:
      description: SD4HC variant - use legacy DLL delay properties
      properties:
        cdns,iocell-input-delay: false
        cdns,iocell-output-delay: false
        cdns,delay-element: false

unevaluatedProperties: false

examples:
  - |
    emmc: mmc@5a000000 {
        compatible = "socionext,uniphier-sd4hc", "cdns,sd4hc";
        reg = <0x5a000000 0x400>;
        interrupts = <0 78 4>;
        clocks = <&clk 4>;
        bus-width = <8>;
        mmc-ddr-1_8v;
        mmc-hs200-1_8v;
        mmc-hs400-1_8v;
        cdns,phy-dll-delay-sdclk = <0>;
    };
```

## drivers/net/ethernet/altera/Kconfig
```kconfig
# SPDX-License-Identifier: GPL-2.0-only
config NET_ALTERA_ETH
	tristate "Altera Ethernet drivers"
	depends on HAS_DMA
	help
	  This driver supports ethernet drivers built around Altera
	  Ethernet and DMA IP.

	  If you have a network (Ethernet) IP belonging to this class, say Y.

config INTEL_FPGA_UTIL
	tristate "Utility driver for helper APIs"
	help
	  This driver adds helper APIs for both HSSI SS and etile.

	  To compile this driver as a module, choose M here. The module
	  will be called altera_util.

if NET_ALTERA_ETH

config ALTERA_TSE
	tristate "Altera Triple-Speed Ethernet MAC support"
	depends on PTP_1588_CLOCK
	select PHYLIB
	select PHYLINK
	select PCS_ALTERA_TSE
	help
	imply PTP_1588_CLOCK
	---help---
	help
	  This driver supports the Altera Triple-Speed (TSE) Ethernet MAC.

	  To compile this driver as a module, choose M here. The module
	  will be called alteratse.

config INTEL_FPGA_QSE_LL
	tristate "Altera FPGA Quad-Speed Low Latency Ethernet MAC support"
	select PTP_1588_CLOCK
	select PHYLINK
	help
	  This driver supports the Altera FPGA Low Latency Quad-Speed (QSE)
	  Ethernet MAC.

	  To compile this driver as a module, choose M here. The module
	  will be called intel_fpga_qse_ll.

config INTEL_FPGA_ETILE
	tristate "Altera FPGA E-tile Ethernet MAC support"
	select PTP_1588_CLOCK
	select PHYLINK
	help
	  This driver supports the Altera FPGA E-tile Ethernet MAC.

	  To compile this driver as a module, choose M here. The module
	  will be called intel_fpga_etile.

config INTEL_FPGA_HSSI_XTILE
	tristate "Altera FPGA HSSI based 10/25G Etile/Ftile  MAC driver support"
	select PTP_1588_CLOCK
	select PHYLINK
	help
	  This driver supports the Altera FPGA E/F-tile Ethernet MAC.

	  To compile this driver as a module, choose M here. The module
	  will be called intel_fpga_hssi_xtile.

config INTEL_FPGA_GTS_TILE
        tristate "Altera FPGA HSSI based 10/25G GTS driver support"
        select PTP_1588_CLOCK
        select PHYLINK
        help
          This driver supports the Altera FPGA GTS Ethernet MAC.

          To compile this driver as a module, choose M here. The module
          will be called intel_fpga_hssi_xtile.

config INTEL_FPGA_TOD
	tristate "Altera FPGA ToD driver support"
	help
	  This driver supports the Altera FPGA Time-of-day Clock.

	  To compile this driver as a module, choose M here. The module
	  will be called intel_fpga_tod.

config INTEL_FPGA_FREQ_CTRL
        depends on INTEL_FPGA_TOD
        tristate "Altera FPGA frequency control device specific driver calls"
        help
          This driver supports the Altera FPGA frequency steering

endif

config INTEL_FPGA_HSSISS
	tristate "Altera FPGA HSSI Subsystem support"
	help
	  This driver supports the Altera FPGA HSSI subsystem.

	  To compile this driver as a module, choose M here. The module
	  will be called intel_fpga_hssiss.
```
