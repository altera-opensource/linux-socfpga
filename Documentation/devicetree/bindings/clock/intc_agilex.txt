## Documentation/devicetree/bindings/clock/intc_agilex.txt
```
Device Tree Clock bindings for Intel's SoCFPGA Agilex platform

This binding uses the common clock binding[1].

[1] Documentation/devicetree/bindings/clock/clock-bindings.txt

Required properties:
- compatible : shall be
	"intel,agilex-clkmgr"

- reg : shall be the control register offset from CLOCK_MANAGER's base for the clock.

- #clock-cells : from common clock binding, shall be set to 1.

Example:
	clkmgr: clock-controller@ffd10000 {
		compatible = "intel,agilex-clkmgr";
		reg = <0xffd10000 0x1000>;
		#clock-cells = <1>;
	};
```

## Documentation/devicetree/bindings/hwmon/soc64-hwmon.txt
```
Bindings for SoC64-hwmon temperature and voltage sensors
--------------------------------------------------------

The SoC64-hwmon driver supports reading of temperature and voltage sensors on
64-bit SoCFPGA and eASIC n5x devices.

Required node properties:
- compatible: must be
		"intel,soc64-hwmon"


Sensor subnode format:
----------------------

Under the hwmon node, there are child nodes to define each class of sensor.

Compatible nodes:

-voltage     : A node containing all voltage sensor configuration data
-temperature : A node containing all temperature sensor configuration data

Required properties for each child node:

- label : Specify the human-readable name for the sensor channel
- reg   : Specify the SDM channel of the sensor
	  integer value in the range 0 to 15, that represents the channel used.

There is a limit of 16 sensor entries for each child.

Example:

temp_volt: hwmon {
	compatible = "intel,soc64-hwmon";
	voltage {
		#address-cells = <1>;
		#size-cells = <0>;
		input@2 {
			label = "0.8V VDD";
			reg = <2>;
		};

		input@3 {
			label = "0.8V VDD_SDM";
			reg = <3>;
		};
	};

	temperature {
		#address-cells = <1>;
		#size-cells = <0>;

		input@1 {
			label = "Main Die";
			reg = <1>;
		};
	};
};
```

## Documentation/devicetree/bindings/iio/adc/altr,modular-adc.txt
```
Altera Modular (Dual) ADC

This binding document describes both Altera Modular ADC and Altera Modular Dual
ADC. Both options can be configured during generation time in Qsys. This driver
only supports standard sequencer with Avalon-MM sample storage with up to 64
memory slots.

Required properties:
- compatible: must be one of the following strings.
  "altr,modular-adc-1.0": single ADC configuration
  "altr,modular-dual-adc-1.0": dual ADC configuration

- reg: address and length of the register set for the device. It contains the
  information of registers in the same order as described by reg-names.

- reg-names: should contain the reg names.
  "sequencer_csr": register region for adc sequencer block
  "sample_store_csr": register region for sample store block

- interrupts: interrupt line for ADC.

- altr,adc-mode : ADC configuration.
  1: single ADC mode
  2: dual ADC mode

- altr,adc-slot-count : specify number of conversion slot in use.

- altr,adc<ADC index>-slot-sequence-<slot index>: specify ADC channel
  conversion sequence.
  <ADC index>: instantiated ADC number. Ranges from 1 - 2.
  <slot index>: slot index for ADC memory slot. Ranges from 1 - 64.

- altr,adc-number : specify ADC number when single ADC mode is selected.
  1: 1st ADC
  2: 2nd ADC

Example: single ADC
	modular_adc_0: adc@20000000 {
		compatible = "altr,modular-adc-1.0";
		reg = <0x20000000 0x00000008>,
			<0x20000200 0x00000200>;
		reg-names = "sequencer_csr", "sample_store_csr";
		interrupt-parent = <&gic>;
		interrupts = <8>;
		altr,adc-mode = <1>;
		altr,adc-slot-count = <2>;
		altr,adc1-slot-sequence-1 = <1>;
		altr,adc-number = <1>;
	};

Example: dual ADC
	modular_adc_1: adc@18002000 {
		compatible = "altr,modular-dual-adc-1.0";
		reg = <0x18002000 0x00000008>,
			<0x18002200 0x00000200>;
		reg-names = "sequencer_csr", "sample_store_csr";
		interrupt-parent = <&gic>;
		interrupts = <8>;
		altr,adc-mode = <2>;
		altr,adc-slot-count = <1>;
		altr,adc1-slot-sequence-1 = <6>;
		altr,adc2-slot-sequence-1 = <6>;
	};
```

## Documentation/devicetree/bindings/mtd/altera_quadspi.txt
```
* MTD Altera QUADSPI driver

Required properties:
- compatible: Should be "altr,quadspi-1.0"
- reg: Address and length of the register set  for the device. It contains
  the information of registers in the same order as described by reg-names
- reg-names: Should contain the reg names
  "avl_csr": Should contain the register configuration base address
  "avl_mem": Should contain the data base address
- #address-cells: Must be <1>.
- #size-cells: Must be <0>.
- flash device tree subnode, there must be a node with the following fields:
	- compatible: Should contain the flash name
	- #address-cells: please refer to /mtd/partition.txt
	- #size-cells: please refer to /mtd/partition.txt
	For partitions inside each flash, please refer to /mtd/partition.txt

Example:

			quadspi_controller_0: quadspi@0x180014a0 {
				compatible = "altr,quadspi-1.0";
				reg = <0x180014a0 0x00000020>,
				      <0x14000000 0x04000000>;
				reg-names = "avl_csr", "avl_mem";
				#address-cells = <1>;
				#size-cells = <0>;
				flash0: epcq256@0 {
					compatible = "epcq256-nonjedec";
					#address-cells = <1>;
					#size-cells = <1>;
					partition@0 {
						/* 16 MB for raw data. */
						label = "EPCQ Flash 0 raw data";
						reg = <0x0 0x1000000>;
					};
					partition@1000000 {
						/* 16 MB for jffs2 data. */
						label = "EPCQ Flash 0 JFFS 2";
						reg = <0x1000000 0x1000000>;
					};
				};
			}; //end quadspi@0x180014a0 (quadspi_controller_0)
```

## Documentation/devicetree/bindings/net/altera_qse.txt
```
* Altera Quad-Speed Ethernet MAC driver (QSE)

Required properties:
- compatible: Should be "altr,qse-msgdma-2.0" for MSGDMA with prefetcher based
		implementations.
- reg: Address and length of the register set for the device. It contains
  the information of registers in the same order as described by reg-names
- reg-names: Should contain the reg names
- interrupts: Should contain the QSE interrupts and it's mode.
- interrupt-names: Should contain the interrupt names
  "rx_irq":       DMA Rx dispatcher interrupt
  "tx_irq":       DMA Tx dispatcher interrupt
- rx-fifo-depth: MAC receive FIFO buffer depth in bytes
- tx-fifo-depth: MAC transmit FIFO buffer depth in bytes
- rx-fifo-almost-full: Value that indicates RX FIFO buffer is getting full
- rx-fifo-almost-empty: Value that indicates RX FIFO buffer is getting empty
- phy-mode: See ethernet.txt in the same directory.
- sfp: See sff,sfp.txt in the same directory.
- dma-coherent: Present if DMA operations are coherent.

- altr,has-supplementary-unicast:
		If present, QSE supports additional unicast addresses.
		Otherwise additional unicast addresses are not supported.
- altr,has-ptp:
		If present, QSE supports 1588 timestamping.  Currently only
		supported with the msgdma prefetcher.
- altr,tx-pma-delay-ns:
		MAC Tx PMA digital delay in nanoseconds.
- altr,rx-pma-delay-ns:
		MAC RX PMA digital delay in nanoseconds.
- altr,tx-pma-delay-fns:
		MAX TX PMA digital delay in fractional nanoseconds.
- altr,rx-pma-delay-fns:
		MAX RX PMA digital delay in fractional nanoseconds.
- tx-poll-freq:
		Optional cycle count for Tx prefetcher to poll descriptor
		list.  If not present, defaults to 128, which at 125MHz is
		roughly 1usec.
- rx-poll-freq:
		Optional cycle count for Rx prefetcher to poll descriptor
		list.  If not present, defaults to 128, which at 125MHz is
		roughly 1usec.

Required registers by compatibility string:
- "altr,qse-msgdma-2.0"
	"control_port":		MAC configuration space region.
	"xcvr_ctrl":		PHY transceiver (XCVR) address space region.
	"tx_csr":		DMA Tx dispatcher control and status space region.
	"tx_pref":		DMA Tx prefetcher configuration space region.
	"rx_csr" :		DMA Rx dispatcher control and status space region.
	"rx_pref":		DMA Rx prefetcher configuration space region.
	"tod_ctrl":		Time of Day Control register only required when
				timestamping support is enabled.  Timestamping is
				only supported with the msgdma-2.0 implementation.
	"rx_fifo":		RX FIFO address space region.
	"phy_reconfig_csr":	PHY reconfiguration controller address space region.
	"chan_ready":		Channel ready address space region.

Optional properties:
- local-mac-address: See ethernet.txt in the same directory.
- max-frame-size: See ethernet.txt in the same directory.

Example:

	qse_0_qse: ethernet@0x100020000 {
		compatible = "altr,qse-msgdma-2.0";
		reg-names = "control_port", "xcvr_ctrl", "tod_ctrl",
				"tx_csr", "tx_pref", "rx_csr", "rx_pref",
				"rx_fifo", "phy_reconfig_csr", "chan_ready";
		reg = <0x00000001 0x00020000 0x00001000>,
			<0x00000001 0x00022000 0x00002000>,
			<0x00000001 0x00026000 0x00000040>,
			<0x00000001 0x00000420 0x00000020>,
			<0x00000001 0x00000400 0x00000020>,
			<0x00000001 0x00000520 0x00000020>,
			<0x00000001 0x00000500 0x00000020>,
			<0x00000001 0x00000540 0x00000020>,
			<0x00000001 0x00030100 0x00000010>,
			<0x00000001 0x00000330 0x00000010>;
		dma-coherent;
		phy-mode = "10gbase-kr";
		sfp = <&sfp_eth0>;
		clocks = <&ptp_ctrl_10G_clk>;
		clock-names = "tod_clk";
		interrupt-parent = <&intc>;
		interrupt-names = "tx_irq", "rx_irq";
		interrupts = <0 21 4>,
				<0 22 4>;
		rx-fifo-depth = <0x4000>;
		tx-fifo-depth = <0x4000>;
		rx-fifo-almost-full = <0x10000>;
		rx-fifo-almost-empty = <0x8000>;
		local-mac-address = [00 00 00 00 00 00];
		altr,tx-pma-delay-ns = <0xb>;
		altr,rx-pma-delay-ns = <0xb>;
		altr,tx-pma-delay-fns = <0>;
		altr,rx-pma-delay-fns = <0>;
		altr,has-ptp;
	};

	sfp_eth0: sfp-eth0 {
		compatible = "sff,sfp";
		i2c-bus = <&i2c0>;
		los-gpio = <&sfp_gpio 0 GPIO_ACTIVE_HIGH>;
		mod-def0-gpio = <&sfp_gpio 2 GPIO_ACTIVE_LOW>;
		maximum-power-milliwatt = <1000>;
		pinctrl-names = "default";
		pinctrl-0 = <&sfp_gpio>;
		tx-disable-gpio = <&sfp_gpio 0 GPIO_ACTIVE_HIGH>;
		tx-fault-gpio = <&sfp_gpio 1 GPIO_ACTIVE_HIGH>;
		rate-select0-gpio = <&sfp_gpio 2 GPIO_ACTIVE_HIGH>;
	};
```
