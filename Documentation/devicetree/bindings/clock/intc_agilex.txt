## Documentation/devicetree/bindings/net/altera_tse.txt
```
* Altera Triple-Speed Ethernet MAC driver (TSE)

Required properties:
- compatible: Should be "altr,tse-1.0" for legacy SGDMA based TSE, and should
		be "altr,tse-msgdma-1.0" for the preferred MSGDMA based TSE,
		and "altr,tse-msgdma-2.0" for MSGDMA with prefetcher based
		implementations.
		ALTR is supported for legacy device trees, but is deprecated.
		altr should be used for all new designs.
- reg: Address and length of the register set for the device. It contains
  the information of registers in the same order as described by reg-names
- reg-names: Should contain the reg names
- interrupts: Should contain the TSE interrupts and it's mode.
- interrupt-names: Should contain the interrupt names
  "rx_irq":       DMA Rx dispatcher interrupt
  "tx_irq":       DMA Tx dispatcher interrupt
- rx-fifo-depth: MAC receive FIFO buffer depth in bytes
- tx-fifo-depth: MAC transmit FIFO buffer depth in bytes
- phy-mode: See ethernet.txt in the same directory.
- phy-handle: See ethernet.txt in the same directory.
- phy-addr: See ethernet.txt in the same directory. A configuration should
		include phy-handle or phy-addr.
- mdio device tree subnode: When the TSE has a phy connected to its local
		mdio, there must be device tree subnode with the following
		required properties:
	- compatible: Must be "altr,tse-mdio".
	- #address-cells: Must be <1>.
	- #size-cells: Must be <0>.

	For each phy on the mdio bus, there must be a node with the following
	fields:
	- reg: phy id used to communicate to phy.
	- device_type: Must be "ethernet-phy".

The MAC address will be determined using the optional properties defined in
ethernet.txt.

- altr,has-supplementary-unicast:
		If present, TSE supports additional unicast addresses.
		Otherwise additional unicast addresses are not supported.
- altr,has-hash-multicast-filter:
		If present, TSE supports a hash based multicast filter.
		Otherwise, hash-based multicast filtering is not supported.
- altr,has-ptp:
		If present, TSE supports 1588 timestamping.  Currently only
		supported with the msgdma prefetcher.
- altr,tx-poll-cnt:
		Optional cycle count for Tx prefetcher to poll descriptor
		list.  If not present, defaults to 128, which at 125MHz is
		roughly 1usec. Only for "altr,tse-msgdma-2.0".
- altr,rx-poll-cnt:
		Optional cycle count for Tx prefetcher to poll descriptor
		list.  If not present, defaults to 128, which at 125MHz is
		roughly 1usec. Only for "altr,tse-msgdma-2.0".

Required registers by compatibility string:
 - "altr,tse-1.0"
	"control_port": MAC configuration space region
	"tx_csr":       DMA Tx dispatcher control and status space region
	"rx_csr" :      DMA Rx dispatcher control and status space region
	"s1":		DMA descriptor memory

 - "altr,tse-msgdma-1.0"
	"control_port": MAC configuration space region
	"tx_csr":       DMA Tx dispatcher control and status space region
	"tx_desc":      DMA Tx dispatcher descriptor space region
	"rx_csr" :      DMA Rx dispatcher control and status space region
	"rx_desc":      DMA Rx dispatcher descriptor space region
	"rx_resp":      DMA Rx dispatcher response space region

 - "altr,tse-msgdma-2.0"
	"control_port": MAC configuration space region
	"tx_csr":       DMA Tx dispatcher control and status space region
	"tx_pref":      DMA Tx prefetcher configuration space region
	"rx_csr" :      DMA Rx dispatcher control and status space region
	"rx_pref":      DMA Rx prefetcher configuration space region
	"tod_ctrl":     Time of Day Control register only required when
			timestamping support is enabled.  Timestamping is
			only supported with the msgdma-2.0 implementation.

Optional properties:
- local-mac-address: See ethernet.txt in the same directory.
- max-frame-size: See ethernet.txt in the same directory.

Example:

	tse_sub_0_eth_tse_0: ethernet@1,00000000 {
		compatible = "altr,tse-msgdma-1.0";
		reg =	<0x00000001 0x00000000 0x00000400>,
			<0x00000001 0x00000460 0x00000020>,
			<0x00000001 0x00000480 0x00000020>,
			<0x00000001 0x000004A0 0x00000008>,
			<0x00000001 0x00000400 0x00000020>,
			<0x00000001 0x00000420 0x00000020>;
		reg-names = "control_port", "rx_csr", "rx_desc", "rx_resp", "tx_csr", "tx_desc";
		interrupt-parent = <&hps_0_arm_gic_0>;
		interrupts = <0 41 4>, <0 40 4>;
		interrupt-names = "rx_irq", "tx_irq";
		rx-fifo-depth = <2048>;
		tx-fifo-depth = <2048>;
		address-bits = <48>;
		max-frame-size = <1500>;
		local-mac-address = [ 00 00 00 00 00 00 ];
		phy-mode = "gmii";
		altr,has-supplementary-unicast;
		altr,has-hash-multicast-filter;
		phy-handle = <&phy0>;
		mdio {
			compatible = "altr,tse-mdio";
			#address-cells = <1>;
			#size-cells = <0>;
			phy0: ethernet-phy@0 {
				reg = <0x0>;
				device_type = "ethernet-phy";
			};

			phy1: ethernet-phy@1 {
				reg = <0x1>;
				device_type = "ethernet-phy";
			};

			phy2: ethernet-phy@2 {
				reg = <0x2>;
				device_type = "ethernet-phy";
			};

		};
	};

	tse_sub_1_eth_tse_0: ethernet@1,00001000 {
		compatible = "altr,tse-msgdma-1.0";
		reg = 	<0x00000001 0x00001000 0x00000400>,
			<0x00000001 0x00001460 0x00000020>,
			<0x00000001 0x00001480 0x00000020>,
			<0x00000001 0x000014A0 0x00000008>,
			<0x00000001 0x00001400 0x00000020>,
			<0x00000001 0x00001420 0x00000020>;
		reg-names = "control_port", "rx_csr", "rx_desc", "rx_resp", "tx_csr", "tx_desc";
		interrupt-parent = <&hps_0_arm_gic_0>;
		interrupts = <0 43 4>, <0 42 4>;
		interrupt-names = "rx_irq", "tx_irq";
		rx-fifo-depth = <2048>;
		tx-fifo-depth = <2048>;
		address-bits = <48>;
		max-frame-size = <1500>;
		local-mac-address = [ 00 00 00 00 00 00 ];
		phy-mode = "gmii";
		altr,has-supplementary-unicast;
		altr,has-hash-multicast-filter;
		phy-handle = <&phy1>;
	};


	tse_sub_2_eth_tse_0: ethernet@1,00002000 {
		compatible = "altr,tse-msgdma-2.0";
		reg = 	<0x00000001 0x00002000 0x00000400>,
			<0x00000001 0x00002400 0x00000020>,
			<0x00000001 0x00002420 0x00000020>,
			<0x00000001 0x00002440 0x00000020>,
			<0x00000001 0x00002460 0x00000020>,
			<0x00000001 0x00002480 0x00000040>;
		reg-names = "control_port", "rx_csr", "rx_pref","tx_csr", "tx_pref", "tod_ctrl";
		interrupt-parent = <&hps_0_arm_gic_0>;
		interrupts = <0 45 4>, <0 44 4>;
		interrupt-names = "rx_irq", "tx_irq";
		rx-fifo-depth = <2048>;
		tx-fifo-depth = <2048>;
		address-bits = <48>;
		max-frame-size = <1500>;
		local-mac-address = [ 00 00 00 00 00 00 ];
		phy-mode = "sgmii";
		altr,has-supplementary-unicast;
		altr,has-hash-multicast-filter;
		altr,has-ptp;
		altr,tx-poll-cnt = <128>;
		altr,rx-poll-cnt = <32>;
		phy-handle = <&phy2>;
	};
```

## Documentation/devicetree/bindings/net/intel,etile.yaml
```yaml
# SPDX-License-Identifier: (GPL-2.0-only OR BSD-2-Clause)
%YAML 1.2
---
$id: http://devicetree.org/schemas/net/intel,etile.yaml#
$schema: http://devicetree.org/meta-schemas/core.yaml#

title: Intel FPGA E-Tile Ethernet MAC Controller

maintainers:
  - Tham, Mun Yew <mun.yew.tham@intel.com>

select:
  properties:
    compatible:
      contains:
        enum:
          - altr,etile-msgdma-2.0
  required:
    - compatible

allOf:
  - $ref: "intel,etile.yaml#"
  - if:
      properties:
        compatible:
          contains:
            enum:
              - altr,etile-msgdma-2.0

    then:
      properties:
        regs:
          items:
            - description:
                Address and length of the register set for the device.
                It contains the information of registers in the same
                order as described by reg-names.

        reg-names:
          items:
            - description: Should contain the register names.

        interrupts:
          items:
            - description:
                Should contain the E-Tile interrupts and it's mode.

        interrupts-names:
          items:
            - description: DMA Rx dispatcher interrupt.
            - description: DMA Tx dispatcher interrupt.
            - const: rx_irq
            - const: tx_irq

        clocks:
          items:
            - description: The clock which drives the timing adjustment logic

        clock-names:
          items:
            - const: tod_clk

        rx-fifo-depth:
          $ref: /schemas/types.yaml#/definitions/uint32
          description: MAC receive FIFO buffer depth in bytes.

        tx-fifo-depth:
          $ref: /schemas/types.yaml#/definitions/uint32
          description: MAC transmit FIFO buffer depth in bytes.

        rx-fifo-almost-full:
          $ref: /schemas/types.yaml#/definitions/uint32
          description: Value that indicates RX FIFO buffer is getting full.

        rx-fifo-almost-empty:
          $ref: /schemas/types.yaml#/definitions/uint32
          description: Value that indicates RX FIFO buffer is getting empty.

        qsfp:
          description: See sff,sfp.txt in the same directory.

        altr,tx-pma-delay-ns:
          $ref: /schemas/types.yaml#/definitions/uint32
          description: MAC Tx PMA digital delay in nanoseconds.

        altr,rx-pma-delay-ns:
          $ref: /schemas/types.yaml#/definitions/uint32
          description: MAC RX PMA digital delay in nanoseconds.

        altr,tx-pma-delay-fns:
          $ref: /schemas/types.yaml#/definitions/uint32
          description: MAC TX PMA digital delay in fractional nanoseconds.

        altr,rx-pma-delay-fns:
          $ref: /schemas/types.yaml#/definitions/uint32
          description: MAC RX PMA digital delay in fractional nanoseconds.

        altr,tx-external-phy-delay-ns:
          $ref: /schemas/types.yaml#/definitions/uint32
          description: External TX PHY delay in fractional nanoseconds.

        altr,rx-external-phy-delay-ns:
          $ref: /schemas/types.yaml#/definitions/uint32
          description: External RX PHY delay in fractional nanoseconds.

examples:

  etile_0_etile: ethernet@0x102001000 {
    compatible = "altr,etile-msgdma-2.0";
    reg-names = "rsfec", "eth_reconfig", "xcvr", "tod_ctrl",
                "tx_pref", "tx_csr", "rx_pref", "rx_csr",
                "rx_fifo";
    reg = <0x00000001 0x02001000 0x00000800>,
          <0x00000001 0x02080000 0x00004000>,
          <0x00000001 0x02100000 0x00080000>,
          <0x00000001 0x02000040 0x00000040>,
          <0x00000001 0x02000800 0x00000020>,
          <0x00000001 0x02000820 0x00000020>,
          <0x00000001 0x02000900 0x00000020>,
          <0x00000001 0x02000920 0x00000020>,
          <0x00000001 0x02000940 0x00000020>;
    //dma-coherent;
    phy-mode = "25gbase-kr";
    qsfp = <&qsfp_eth0>;
    clocks = <&ptp_ctrl_10G_clk>;
    clock-names = "tod_clk";
    interrupt-parent = <&intc>;
    interrupt-names = "tx_irq", "rx_irq";
    interrupts = <0 24 4>,
                 <0 25 4>;
    rx-fifo-depth = <0x4000>;
    tx-fifo-depth = <0x1000>;
    rx-fifo-almost-full = <0x2000>;
    rx-fifo-almost-empty = <0x1000>;
    //local-mac-address = [fa b1 0a 12 72 44];
    altr,tx-pma-delay-ns = <0xD>;
    altr,rx-pma-delay-ns = <0x8>;
    altr,tx-pma-delay-fns = <0x24D>;
    altr,rx-pma-delay-fns = <0x3E97>;
    altr,tx-external-phy-delay-ns = <0x0>;
    altr,rx-external-phy-delay-ns = <0x0>;
    fec-type = "kr-fec";
    fec-cw-pos-rx = <3>;
    altr,has-ptp;
    status = "okay";
  };

  qsfp_eth0: qsfp-eth0 {
    compatible = "sff,qsfp";
    i2c-bus = <&i2c0>;
    qsfpdd_initmode-gpio = <&qsfpdd_status_pio_1 0 GPIO_ACTIVE_HIGH>;
    qsfpdd_modseln-gpio = <&qsfpdd_status_pio_1 2 GPIO_ACTIVE_LOW>;
    qsfpdd_modprsn-gpio = <&qsfpdd_status_pio 0 GPIO_ACTIVE_LOW>;
    qsfpdd_resetn-gpio = <&qsfpdd_status_pio_1 1 GPIO_ACTIVE_LOW>;
    qsfpdd_intn-gpio = <&qsfpdd_status_pio 1 GPIO_ACTIVE_LOW>;
    maximum-power-milliwatt = <1000>;
    status = "okay";
  };
```

## Documentation/devicetree/bindings/net/stmmac.txt
```
* STMicroelectronics 10/100/1000 Ethernet driver (GMAC)

Required properties:
- compatible: Should be "snps,dwmac-<ip_version>" "snps,dwmac"
	For backwards compatibility: "st,spear600-gmac" is also supported.
- reg: Address and length of the register set for the device
- interrupt-parent: Should be the phandle for the interrupt controller
  that services interrupts for this device
- interrupts: Should contain the STMMAC interrupts
- interrupt-names: Should contain the interrupt names "macirq"
  "eth_wake_irq" if this interrupt is supported in the "interrupts"
  property
- phy-mode: String, operation mode of the PHY interface.
  Supported values are: "mii", "rmii", "gmii", "rgmii".
- snps,multicast-filter-bins:	Number of multicast filter hash bins
				supported by this device instance
- snps,perfect-filter-entries:	Number of perfect filter entries supported
				by this device instance

Optional properties:
- mac-address: 6 bytes, mac address
- resets: Should contain a phandle to the STMMAC reset signal, if any
- reset-names: Should contain the reset signal name "stmmaceth", if a
	reset phandle is given
- max-frame-size: See ethernet.txt file in the same directory
- clocks: If present, the first clock should be the GMAC main clock,
  further clocks may be specified in derived bindings.
- clock-names: One name for each entry in the clocks property, the
  first one should be "stmmaceth".
- clk_ptp_ref: this is the PTP reference clock; in case of the PTP is
  available this clock is used for programming the Timestamp Addend Register.
  If not passed then the system clock will be used and this is fine on some
  platforms.
- snps,burst_len: The AXI burst lenth value of the AXI BUS MODE register.
- tx-fifo-depth: See ethernet.txt file in the same directory
- rx-fifo-depth: See ethernet.txt file in the same directory

Examples:

	gmac0: ethernet@e0800000 {
		compatible = "st,spear600-gmac";
		reg = <0xe0800000 0x8000>;
		interrupt-parent = <&vic1>;
		interrupts = <24 23>;
		interrupt-names = "macirq", "eth_wake_irq";
		mac-address = [000000000000]; /* Filled in by U-Boot */
		phy-mode = "gmii";
		snps,max-mtu = <4062>;
		snps,multicast-filter-bins = <256>;
		snps,perfect-filter-entries = <128>;
		rx-fifo-depth = <16384>;
		tx-fifo-depth = <16384>;
		clocks = <&clock>;
		clock-names = "stmmaceth";
	};
```

## Documentation/devicetree/bindings/phy/intel,qsfp-mem.txt
```
* Intel QSFP Memory controller subsystem

Required properties:
- compatible: Should be "intel,qsfp-mem"
- reg: Address and length of the register set for the device. It contains
  the information of registers in the same order as described by reg-names
- reg-names: Should contain the reg names

Example:

		qsfp_eth0: qsfp-eth0 {
			   compatible = "intel,qsfp-mem";
			   reg-names = "qsfp-mem-controller";
			   reg = <0x00000001 0x80112000 0x00001000>,
			   status = "okay";
		};
```
