// SPDX-License-Identifier: GPL-2.0-only
/*
 * Copyright (C) 2026, Altera Corporation
 *
 * SoCFPGA Agilex3 SoCDK cfg2 - enables gmac1 with MaxLinear MXL86111C PHY.
 */
#include "socfpga_agilex3_socdk.dts"

&gmac1 {
	status = "okay";
	phy-mode = "rgmii-txid"; /* TX clock delay provided by MAC hardware */
	mac-mode = "gmii";
	phy-handle = <&emac1_phy0>;
	max-frame-size = <9000>;

	mdio0 {
		#address-cells = <1>;
		#size-cells = <0>;
		compatible = "snps,dwmac-mdio";

		emac1_phy0: ethernet-phy@4 {
			reg = <4>;
		};
	};
};
