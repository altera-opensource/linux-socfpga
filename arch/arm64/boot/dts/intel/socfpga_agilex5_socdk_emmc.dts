// SPDX-License-Identifier:     GPL-2.0
/*
 * Copyright (C) 2025, Altera Corporation
 */
#include "socfpga_agilex5_socdk_nand.dts"

/ {
	model = "SoCFPGA Agilex5 SoCDK eMMC";
	compatible = "intel,socfpga-agilex5-socdk", "intel,socfpga-agilex";
};

&mmc {
	status = "okay";

	no-sd;
	no-sdio;
	disable-wp;
	non-removable;
	cap-mmc-highspeed;
	mmc-hs400-1_8v;
	mmc-hs200-1_8v;
	bus-width = <8>;
	vmmc-supply = <&sd_emmc_power>;
	vqmmc-supply = <&emmc_io_1v8_reg>;
	max-frequency = <200000000>;
	sdhci-caps = <0x00000000 0x0000c800>;
	sdhci-caps-mask = <0x00002000 0x0000ff00>;
};

&nand {
	status = "disabled";
};
