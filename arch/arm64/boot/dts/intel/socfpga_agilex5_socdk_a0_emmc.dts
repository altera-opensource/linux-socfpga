// SPDX-License-Identifier:     GPL-2.0
/*
 * Copyright (C) 2026, Altera Corporation
 */
#include "socfpga_agilex5_socdk_emmc.dts"

/ {
	model = "SoCFPGA Agilex5 SoCDK A0 eMMC development kit";
};

&mmc {
	no-1-8-v;
	/delete-property/ mmc-hs400-1_8v;
	/delete-property/ mmc-hs200-1_8v;
};
